## main/Kconfig.projbuild
```kconfig
menu "Example Configuration"

    config EXAMPLE_WIFI_SSID
        string "Wi-Fi SSID"
        default "myssid"
        help
            SSID of the Wi-Fi network to connect to (STA mode).

    config EXAMPLE_WIFI_PASSWORD
        string "Wi-Fi Password"
        default "mypassword"
        help
            Password of the Wi-Fi network to connect to (STA mode).

endmenu
```

## sdkconfig.defaults
```kconfig
# Ethernet configuration for ESP32-P4-NANO
# IP101GRI PHY chip with RMII interface
CONFIG_ETHERNET_MDC_GPIO=31
CONFIG_ETHERNET_MDIO_GPIO=52
CONFIG_ETHERNET_PHY_RST_GPIO=51
CONFIG_ETHERNET_PHY_ADDR=1
CONFIG_ETHERNET_PHY_IP101=y

# Wi-Fi AP configuration
CONFIG_EXAMPLE_WIFI_SSID="ESP32-P4-NANO-WiFi"
CONFIG_EXAMPLE_WIFI_PASSWORD="12345678"
```
